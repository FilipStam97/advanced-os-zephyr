## CMakeLists.txt
```
# Minimum CMake required version
cmake_minimum_required( VERSION 3.20.0 )

# set enviroment variables like the board in use
set(BOARD native_sim)

# Get Zephyr directory
find_package(Zephyr REQUIRED HINTS $ENV{ZEPHYR_BASE})

# Project name and source files
project(Sim)
target_sources(app PRIVATE src/main.c)
```

## prj.conf
```kconfig
CONFIG_PRINTK=y
CONFIG_CONSOLE=y
CONFIG_STDOUT_CONSOLE=y


CONFIG_GPIO=y
CONFIG_GPIO_EMUL=y
```

## src/main.c
```c
#include <zephyr/kernel.h>
#include <zephyr/drivers/gpio.h>
#include <zephyr/drivers/gpio/gpio_emul.h>
#include <string.h>
#include <stdlib.h>
#include <stdbool.h>
#include <zephyr/sys/printk.h>

#define THRESHOLD_C 25.0
#define PERIOD_MS 1000



static const struct gpio_dt_spec led = GPIO_DT_SPEC_GET(DT_ALIAS(led0), gpios);
int get_led_output( const struct gpio_dt_spec *led );

/* Simulated sensor  */
static int simulated_temp_c(void)
{
    uint32_t t = k_uptime_get_32();
    return 18 + (t % 13);   //  from 18 to 30
}

int main(void)
{
    gpio_pin_configure_dt(&led, GPIO_OUTPUT_INACTIVE);

    bool actuator_on = false;

    printk("UART-simulated sensor demo (native_sim)\n");
    printk("Temperature threshold = %d C\n\n", THRESHOLD_C);

    if (!gpio_is_ready_dt(&led)) {
        printk("LED GPIO not ready\n");
        return 0;
    }


    while (1)
    {
  
        int temp = simulated_temp_c();
        printk("Sensor(temp) = %.2f C\n", temp);

        if (!actuator_on && temp >= THRESHOLD_C) {
            actuator_on = true;
            gpio_pin_set_dt(&led, 1);
            printk("---> ACTUATOR: LED ON\n");
        } else if (actuator_on && temp < THRESHOLD_C) {
            actuator_on = false;
            gpio_pin_set_dt(&led, 0);
            printk("---> ACTUATOR: LED OFF\n");
        }
        printk("Emulated LED pin value = %d\n\n", get_led_output(&led));
         k_msleep(PERIOD_MS);
    }

    return 0;
}

int get_led_output( const struct gpio_dt_spec *led )
{
    /*ge the emulated device from the led0 node, wich is basically gpio0*/
    const struct device *dev = device_get_binding(led->port->name);
    return gpio_emul_output_get(dev, 0);
}
```
